## Kconfig
```kconfig
menu "Siren Synth"

    config SIREN_SYNTH_ENABLED
        bool "Enable Siren Synth"
        default y
        help
            Enable the siren synthesis component.

endmenu
```

## examples/ws-esp32-p4-wifi6-console-siren-dev/sdkconfig.defaults
```kconfig
# ============================================================================
# ESP32-P4 Hardware Target Configuration
# ============================================================================
CONFIG_IDF_TARGET="esp32p4"
CONFIG_ESP32P4_SELECTS_REV_LESS_V3=y

# ============================================================================
# Flash size detected on this board (32 MB Nor Flash)
# ============================================================================
CONFIG_ESPTOOLPY_FLASHMODE_QIO=y
CONFIG_ESPTOOLPY_FLASHSIZE_32MB=y

# ============================================================================
# Console/UART Configuration
# ============================================================================
CONFIG_ESP_CONSOLE_UART_DEFAULT=y

# ============================================================================
# Logging Configuration
# ============================================================================
CONFIG_LOG_DEFAULT_LEVEL_INFO=y
CONFIG_LOG_MAXIMUM_LEVEL_DEBUG=y
```
